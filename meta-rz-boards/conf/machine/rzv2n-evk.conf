## meta-rz-boards/conf/machine/rzv2n-evk.conf
```bitbake
#@TYPE: Machine
#@NAME: rzv2n-evk machine
#@DESCRIPTION: RZ/V2N Development Board platform

require conf/machine/include/arm/armv8-2a/tune-cortexa55.inc
require conf/machine/include/rz-common.inc
require conf/machine/include/rzv2h-family.inc

# Trusted Firmware-A configuration
PREFERRED_VERSION_trusted-firmware-a ?= "2.7%"
TFA_PLATFORM ?= "v2n"
TFA_BOARD ?= "evk_1 ENABLE_STACK_PROTECTOR=default"
TFA_UBOOT ?= "1"
TFA_BUILD_TARGET ?= "bl2 bl31 fip"
BL2_BOOT_TARGET ?= "spi mmc esd"

UBOOT_CONFIG ??= "rzv2n-evk"
UBOOT_CONFIG[rzv2n-evk] = "rzv2n-evk_defconfig"
PREFERRED_VERSION_u-boot = "v2021.10%"

#todo temporary has no flash writer
# Flash Writer configuration
# FLASH_WRITER_BOARD ?= ""

# Supported devicetree
KERNEL_IMAGETYPE ?= "Image"
KERNEL_DEVICETREE = " \
	renesas/r9a09g056n44-evk.dtb \
"

IMAGE_BOOT_FILES = " \
	bl2_bp_spi-${MACHINE}.bin \
	bl2_bp_mmc-${MACHINE}.bin \
	bl2_bp_spi-${MACHINE}.srec \
	bl2_bp_mmc-${MACHINE}.srec \
	fip-${MACHINE}.srec \
	Flash_Writer_SCIF_RZV2N_DEV_LPDDR4X.mot \
"
#todo temporary has no flash writer add do_image_wic[noexec] to local.conf
WIC_INPUT_DEPENDS = "firmware-pack:do_deploy flash-writer:do_deploy"
```
